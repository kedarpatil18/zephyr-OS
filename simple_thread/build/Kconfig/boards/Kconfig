## simple_thread/build/Kconfig/boards/Kconfig
```kconfig
# Load Zephyr board Kconfig descriptions.
osource "/home/kpatil2/zephyrproject/zephyr/boards/st/nucleo_f746zg/Kconfig"
```

## simple_thread/build/Kconfig/boards/Kconfig.sysbuild
```kconfig
# Load Sysbuild board Kconfig descriptions.
osource "/home/kpatil2/zephyrproject/zephyr/boards/st/nucleo_f746zg/Kconfig.sysbuild"
```

## thread_1/build/Kconfig/arch/Kconfig
```kconfig
# Load Zephyr Arch Kconfig descriptions.
osource "/home/kpatil2/zephyrproject/zephyr/arch/x86/Kconfig"
osource "/home/kpatil2/zephyrproject/zephyr/arch/xtensa/Kconfig"
osource "/home/kpatil2/zephyrproject/zephyr/arch/sparc/Kconfig"
osource "/home/kpatil2/zephyrproject/zephyr/arch/riscv/Kconfig"
osource "/home/kpatil2/zephyrproject/zephyr/arch/posix/Kconfig"
osource "/home/kpatil2/zephyrproject/zephyr/arch/nios2/Kconfig"
osource "/home/kpatil2/zephyrproject/zephyr/arch/mips/Kconfig"
osource "/home/kpatil2/zephyrproject/zephyr/arch/arm64/Kconfig"
osource "/home/kpatil2/zephyrproject/zephyr/arch/arm/Kconfig"
osource "/home/kpatil2/zephyrproject/zephyr/arch/arc/Kconfig"
```

## thread_1/build/Kconfig/boards/Kconfig.defconfig
```kconfig
# Load Zephyr board defconfig descriptions.
osource "/home/kpatil2/zephyrproject/zephyr/boards/st/nucleo_f746zg/Kconfig.defconfig"
```
